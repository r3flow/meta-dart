## conf/layer.conf
```bitbake
# We have a conf and classes directory, append to BBPATH
BBPATH .= ":${LAYERDIR}"

BBFILES += "${LAYERDIR}/recipes*/*/*.bb ${LAYERDIR}/recipes*/*/*.bbappend ${LAYERDIR}/images/*.bb"

BBFILE_COLLECTIONS += "meta-dart"
BBFILE_PATTERN_meta-dart := "^${LAYERDIR}/"
BBFILE_PRIORITY_meta-dart = "11"

LAYERSERIES_COMPAT_meta-dart = "mickledore langdale kirkstone honister hardknott gatesgarth"
```
